## conf/layer.conf
```bitbake
# We have a conf and classes directory, add to BBPATH
BBPATH .= ":${LAYERDIR}"

# We have a recipes-* directories, add to BBFILES
BBFILES += "${LAYERDIR}/recipes-*/*/*.bb \
	${LAYERDIR}/recipes-*/*/*.bbappend"

BBFILE_COLLECTIONS += "iot2000-sensorgateway"
BBFILE_PATTERN_iot2000-sensorgateway = "^${LAYERDIR}/"
BBFILE_PRIORITY_iot2000-sensorgateway = "6"

#LAYERDEPENDS_iot2000-sensorgateway += " iot2000-bsp meta-java intel-iot-mw "
LAYERDEPENDS_iot2000-sensorgateway += " iot2000-bsp "

IOT2000SENSORGATEWAY_MIT_LICENSE = "${LAYERDIR}/COPYING.MIT"
IOT2000SENSORGATEWAY_GPLv2_LICENSE = "${LAYERDIR}/COPYING.GPLv2"

PREFERRED_VERSION_nodejs = "6.9.5"
```
